## main/Kconfig
```kconfig
menu "Horloge Wi-Fi"

config APP_WIFI_SSID
    string "Nom du reseau Wi-Fi"
    default "MonWifi"
    help
        SSID used to connect to the network for time synchronization.

config APP_WIFI_PASSWORD
    string "Mot de passe Wi-Fi"
    default ""
    help
        Password used to connect to the network for time synchronization.

endmenu
```

## sdkconfig.defaults
```kconfig
CONFIG_IDF_TARGET="esp32s3"
CONFIG_SPIRAM=y
CONFIG_SPIRAM_MODE_OCT=y
CONFIG_SPIRAM_SPEED_80M=y
CONFIG_ESPTOOLPY_FLASHSIZE_4MB=y
CONFIG_ESP_MAIN_TASK_STACK_SIZE=8192
CONFIG_MBEDTLS_CERTIFICATE_BUNDLE=y
CONFIG_LV_USE_FONT_MONTSERRAT_14=y
CONFIG_LV_FONT_MONTSERRAT_14=y
CONFIG_LV_FONT_MONTSERRAT_20=y
CONFIG_LV_FONT_MONTSERRAT_48=y
CONFIG_LV_USE_STDLIB_MALLOC=1
```
